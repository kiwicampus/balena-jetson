## layers/meta-balena-jetson/conf/machine/kiwi-orin.conf
```bitbake
#@TYPE: Machine
##@NAME: kiwi-orin
##@DESCRIPTION: Machine configuration for the Jetson Xavier AGX Devkit

MACHINEOVERRIDES = "jetson-agx-orin-devkit:${MACHINE}"
include conf/machine/jetson-agx-orin-devkit.conf

MACHINEOVERRIDES := "${@'${MACHINEOVERRIDES}'.replace(':${MACHINE}',':jetson-agx-orin-devkit:${MACHINE}')}"
```

## layers/meta-balena-jetson/conf/machine/kiwi-xavier.conf
```bitbake
#@TYPE: Machine
##@NAME: kiwi-xavier
##@DESCRIPTION: Machine configuration for the Kiwi Xavier Carrier Board for NVidia Jetson Xavier

MACHINEOVERRIDES = "jetson-agx-xavier-devkit:${MACHINE}"
include conf/machine/jetson-agx-xavier-devkit.conf

MACHINEOVERRIDES := "${@'${MACHINEOVERRIDES}'.replace(':${MACHINE}',':jetson-agx-xavier-devkit:${MACHINE}')}"
```
